/dts-v1/;
/plugin/;	/* allow undefined label references and record them */
/ {
	fragment@0 {
		target = <&elf2>;
		__overlay__ {
			#address-cells = <1>;
			#size-cells = <0>;			
			dac1@12 {
				compatible="ad5675r";
				reg=<0x0c>;
			};
		};
	};
};
